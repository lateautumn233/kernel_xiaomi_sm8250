## drivers/fragmention/Kconfig
```kconfig
#
# fragmention driver
#

config FRAGMENTION
	tristate "fragmention"
	default y
	help
	  fragmention driver.
```

## drivers/mihw/Kconfig
```kconfig
config MILLET
	bool "frozen framework"
	depends on MIHW
	help
	  Mi frozen function

config MIGT
	bool "smart sched"
	depends on MIHW
	help
	  Boost cpufreq when current frame drawing time too long
```

## drivers/platform/xiaomi/Kconfig
```kconfig
# Xiaomi configuration options

config MACH_XIAOMI_SM8250
	bool "Xiaomi SM8250"
	depends on ARCH_QCOM
	depends on ARCH_KONA
	help
	  Support for SM8250 Xiaomi variants

menu "Xiaomi board selection"

	config MACH_XIAOMI_UMI
		bool "MI 10 board"
		depends on MACH_XIAOMI_SM8250
		help
		  Support for MI 10 variant

	config MACH_XIAOMI_CMI
		bool "MI 10 Pro board"
		depends on MACH_XIAOMI_SM8250
		help
		  Support for MI 10 Pro variant

	config MACH_XIAOMI_LMI
		bool "Redmi K30 Pro board"
		depends on MACH_XIAOMI_SM8250
		help
		  Support for Redmi K30 Pro variant
		  
	config MACH_XIAOMI_CAS
		bool "MI 10 Ultra board"
		depends on MACH_XIAOMI_SM8250
		help
		  Support for MI 10 Ultra variant
		  
	config MACH_XIAOMI_APOLLO
		bool "Redmi K30 Ultra board"
		depends on MACH_XIAOMI_SM8250
		help
		  Support for Redmi K30 Ultra variant

endmenu
```
